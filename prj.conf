## CMakeLists.txt
```
# CMakeLists.txt (top-level, next to prj.conf)
cmake_minimum_required(VERSION 3.20.0)

# Find Zephyr
find_package(Zephyr REQUIRED HINTS $ENV{ZEPHYR_BASE})
project(app)

# App sources
target_sources(app PRIVATE
  src/main.c
  src/ipc.c
  src/serial/serial_io.c
  src/proto/payload.c
  src/proto/parser_worker.c
  src/workers/tx_worker.c
  src/producers/producer_a.c
  src/producers/producer_b.c
  src/ble/ble_service.c
)

# Public headers live in these folders
target_include_directories(app PRIVATE
  src
  src/serial
  src/proto
  src/ble
  src/workers
  src/producers
)
```

## prj.conf
```kconfig
CONFIG_LOG=y
CONFIG_LOG_DEFAULT_LEVEL=3
CONFIG_SERIAL=y
CONFIG_CONSOLE=y
CONFIG_UART_CONSOLE=y
CONFIG_UART_ASYNC_API=y

# --- Bluetooth Peripheral/GATT ---
CONFIG_BT=y
CONFIG_BT_PERIPHERAL=y
CONFIG_BT_DEVICE_NAME="AB-Async"
CONFIG_BT_DEVICE_APPEARANCE=0

# GATT/ATT (default MTU gives 20 B payload; keep simple)
CONFIG_BT_ATT_PREPARE_COUNT=0
# Optional: increase ATT MTU if you plan >20B later
# CONFIG_BT_BUF_ACL_RX_SIZE=251
# CONFIG_BT_L2CAP_TX_MTU=247
```

## nrf52840dk_nrf52840.overlay
```dts
&uart0 {
	current-speed = <19200>;
};
```

## src/main.c
```c
#include <zephyr/kernel.h>
#include <zephyr/logging/log.h>
#include <zephyr/bluetooth/bluetooth.h>   // bt_enable()

#include "config.h"
#include "ipc.h"
#include "serial/serial_io.h"

#include "proto/parser_worker.h"
#include "workers/tx_worker.h"
#include "producers/producers.h"
#include "ble/ble_service.h"              // ble_service_adv_start()

LOG_MODULE_REGISTER(app_main, LOG_LEVEL_INF);

K_THREAD_STACK_DEFINE(parser_stack,  STACK_PARSER);
K_THREAD_STACK_DEFINE(worker_stack,  STACK_TX_WORKER);
K_THREAD_STACK_DEFINE(prod_a_stack,  STACK_PROD);
K_THREAD_STACK_DEFINE(prod_b_stack,  STACK_PROD);


int main(void)
{
    ipc_init();
    serial_io_init();
    
    /* Start application threads */
    parser_worker_start(parser_stack, K_THREAD_STACK_SIZEOF(parser_stack), PRIO_WORKERS);
    tx_worker_start(worker_stack, K_THREAD_STACK_SIZEOF(worker_stack), PRIO_WORKERS);
    producer_a_start(prod_a_stack, K_THREAD_STACK_SIZEOF(prod_a_stack), PRIO_PRODUCERS);
    producer_b_start(prod_b_stack, K_THREAD_STACK_SIZEOF(prod_b_stack), PRIO_PRODUCERS);

    /* Bring up BLE and start advertising */
    ble_start();
    adv_start();

    for (;;) 
    {
        k_sleep(K_FOREVER);
    }
}
```

## src/config.h
```c
/* config.h */
#pragma once
#define AB_RX_CHUNK_LEN          64
#define AB_RX_IDLE_TIMEOUT_US    20000
#define STACK_PARSER             1024
#define STACK_TX_WORKER          1024
#define STACK_PROD               768
#define PRIO_WORKERS             7
#define PRIO_PRODUCERS           8
/* Periods for the producers */
#define AB_PROD_A_PERIOD_MS 10
#define AB_PROD_B_PERIOD_MS 50
/* BLE queue element size and depth */
#define BLE_RX_MAX      20
#define BLE_RX_Q_DEPTH  8
```

## src/ipc.c
```c
/* ipc.c - implementation of inter-thread/ISR communication helpers */
#include "ipc.h"
#include <zephyr/kernel.h>
#include <zephyr/sys/atomic.h>

/* --------- Storage: kept private to this translation unit --------- */

/* RX messages: each element is {evt, data} */
K_MSGQ_DEFINE(ipc_rx_q, sizeof(struct ipc_rx_msg), IPC_RX_Q_LEN, 4);

/* Commands from parser to TX worker */
K_MSGQ_DEFINE(ipc_cmd_q, sizeof(uint8_t), IPC_CMD_Q_LEN, 4);

/* TX completion semaphore (ISR gives, worker takes) */
static struct k_sem tx_done_sem;

/* Soft half-duplex flag (worker sets during TX; ISR checks to drop bytes) */
static atomic_t tx_active;

void ipc_init(void)
{
    k_msgq_purge(&ipc_rx_q);
    k_msgq_purge(&ipc_cmd_q);
    atomic_clear(&tx_active);
    k_sem_init(&tx_done_sem, 0, 1);
}

/* ---- RX queue (pair API) ---- */

bool ipc_rx_put_pair(uint8_t evt, uint8_t data)
{
    struct ipc_rx_msg m = { .evt = evt, .data = data };
    return k_msgq_put(&ipc_rx_q, &m, K_NO_WAIT) == 0;
}

bool ipc_rx_get_pair(struct ipc_rx_msg *m, k_timeout_t to)
{
    return k_msgq_get(&ipc_rx_q, m, to) == 0;
}

/* ---- RX purge ---- */

void ipc_rx_purge(void)
{
    k_msgq_purge(&ipc_rx_q);
}

/* ---- Command queue ---- */

bool ipc_cmd_put(uint8_t cmd)
{
    return k_msgq_put(&ipc_cmd_q, &cmd, K_NO_WAIT) == 0;
}

bool ipc_cmd_get(uint8_t *cmd, k_timeout_t to)
{
    return k_msgq_get(&ipc_cmd_q, cmd, to) == 0;
}

void ipc_cmd_purge(void)
{
    k_msgq_purge(&ipc_cmd_q);
}

/* ---- TX completion ---- */

void ipc_tx_done_give_from_isr(void)
{
    k_sem_give(&tx_done_sem);
}

bool ipc_tx_done_take(k_timeout_t to)
{
    return k_sem_take(&tx_done_sem, to) == 0;
}

/* ---- Soft half-duplex flag ---- */

void ipc_set_tx_active(bool on)
{
    if (on) {
        atomic_set(&tx_active, 1);
    } else {
        atomic_clear(&tx_active);
    }
}

bool ipc_is_tx_active(void)
{
    return atomic_get(&tx_active) != 0;
}
```

## src/ipc.h
```c
#pragma once
#include <zephyr/kernel.h>
#include <stdbool.h>
#include <stdint.h>

/* ------------ RX message (event + data byte) ------------ */
enum {
    IPC_RX_EVT_BYTE  = 0,  /* 'data' holds a received byte */
    IPC_RX_EVT_BREAK = 1,
};

struct ipc_rx_msg {
    uint8_t evt;
    uint8_t data;
};

/* Init */
void ipc_init(void);

/* ---- RX queue (pair API) ---- */
bool ipc_rx_put_pair(uint8_t evt, uint8_t data);             /* ISR-safe */
bool ipc_rx_get_pair(struct ipc_rx_msg *m, k_timeout_t to);  /* thread */

/* ---- Command queue ---- */
bool ipc_cmd_put(uint8_t cmd);
bool ipc_cmd_get(uint8_t *cmd, k_timeout_t to);
void ipc_cmd_purge(void);

/* ---- RX purge ---- */
void ipc_rx_purge(void);

/* ---- TX completion ---- */
void ipc_tx_done_give_from_isr(void);
bool ipc_tx_done_take(k_timeout_t to);

/* ---- Soft half-duplex flag ---- */
void ipc_set_tx_active(bool on);
bool ipc_is_tx_active(void);

/* Tunables */
#ifndef IPC_RX_Q_LEN
#define IPC_RX_Q_LEN   32   /* number of (evt,data) messages */
#endif

#ifndef IPC_CMD_Q_LEN
#define IPC_CMD_Q_LEN   8   /* commands */
#endif
```
